## Kconfig.cbc
```kconfig
config BOARD_CBC
	select SOC_NRF52840_QFAA
	imply RETAINED_MEM
    imply RETENTION
    imply RETENTION_BOOT_MODE
```

## Kconfig.defconfig
```kconfig
config ZMK_KEYBOARD_NAME
    default "CBC"
    
config ZMK_KSCAN_MATRIX_POLLING
    default y

if BOARD_CBC

if USB  

config USB_NRFX
    default y

config USB_DEVICE_STACK
    default y

endif # USB

if ZMK_BACKLIGHT

config PWM
    default y

config LED_PWM
    default y

endif # ZMK_BACKLIGHT

# config BT_CTLR
    # default BT

endif # BOARD_CBC
```

## board.yml
```yaml
board:
  name: cbc
  vendor: chordboard
  socs:
    - name: nrf52840
  revision:
    format: major.minor.patch
    default: 1.0.0
    revisions:
      - name: 1.0.0
```

## cbc_defconfig
```kconfig
# USB configuration
CONFIG_ZMK_USB=y
CONFIG_USB_DEVICE_STACK=y
CONFIG_USB_DEVICE_DRIVER=y
CONFIG_USB_DEVICE_MANUFACTURER="ChordBoardMusic"
CONFIG_USB_CDC_ACM=y
# CONFIG_USB_NRFX=y
# CONFIG_USB_DEVICE_CONTROLLER=y
# CONFIG_USB_DEVICE_DESCRIPTOR=y

# BT configuration
CONFIG_BT=y
CONFIG_BT_PERIPHERAL=y
CONFIG_ZMK_BLE=y
CONFIG_BT_BAS=y
CONFIG_ZMK_BLE_CLEAR_BONDS_ON_START=n
CONFIG_BT_CTLR_PHY_2M=y
CONFIG_BT_MAX_CONN=2
CONFIG_BT_MAX_PAIRED=2
CONFIG_BT_CTLR_TX_PWR_PLUS_8=y
# CONFIG_ZMK_BLE_PASSKEY_ENTRY=y
# CONFIG_BT_CTLR_TX_PWR=8
# CONFIG_CLOCK_CONTROL_NRF_K32SRC_RC=y

# Log configurations
# CONFIG_LOG=y
# CONFIG_ZMK_USB_LOGGING=y
# CONFIG_LOG_DEFAULT_LEVEL=4
# CONFIG_LOG_PROCESS_THREAD_STARTUP_DELAY_MS=8000

# Enable GPIO
CONFIG_GPIO=y
CONFIG_PINCTRL=y

# Clock configuration
CONFIG_CLOCK_CONTROL=y

# Encoder support
CONFIG_EC11=y
CONFIG_EC11_TRIGGER_GLOBAL_THREAD=y
# CONFIG_EC11_TRIGGER_OWN_THREAD=y

#Build configuration
CONFIG_BUILD_OUTPUT_UF2=n
# CONFIG_ZMK_SETTINGS_RESET_ON_START=y

# HID report configuration
CONFIG_ZMK_HID_INDICATORS=y
CONFIG_ZMK_HID_CONSUMER_REPORT_USAGES_FULL=y
CONFIG_ZMK_HID_REPORT_TYPE_HKRO=y

#Battery reporting
CONFIG_ZMK_BATTERY_REPORTING=y
# CONFIG_ZMK_BATTERY_REPORTING_INTERVAL_MS=600

#Configure backlight
CONFIG_I2C=y
CONFIG_LED=y
# CONFIG_LED_IS31FL3733=y
CONFIG_ZMK_BACKLIGHT=n
```
